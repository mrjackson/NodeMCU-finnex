  /*
   * NodeMCU Finnex 24/7 Controller
   * An IR LED must be connected to ESP8266 pin D2.
   * Button/Switch connected to ESP8266 pin D3 pulled low with 10k resistor.
   */
  
  #include <ESP8266WiFi.h>
  #include <WiFiClient.h>
  #include <ESP8266WebServer.h>
  #include <ESP8266mDNS.h>
  #include <IRremoteESP8266.h>
  #include <WiFiManager.h> //https://github.com/tzapu/WiFiManager WiFi Configuration Magic
  #include <DNSServer.h> //Local DNS Server used for redirecting all requests to the configuration portal
  
  #define TRIGGER_PIN 0
    
  MDNSResponder mdns;
  
  ESP8266WebServer server(80);
  
  IRsend irsend(4);
  
  void handleRoot() {
   server.send(200, "text/html", "<html><head> <title>ESP8266 IR Remote</title></head><body><h1>ESP8266 IR Remote</h1><p><a href=\"ir?tv=power\">Test</a></p><p><a href=\"ir?light=power\">Light ON/OFF</a></p><p><a href=\"ir?light=max\">Light MAX</a></p><p><a href=\"ir?light=24hour\">Light 24/7</a></p><p><a href=\"ir?light=12PM\">Light 12PM</a></p><p><a href=\"ir?light=3PM\">Light 3PM</a></p><p><a href=\"ir?light=6PM\">Light 6PM</a></p><p><a href=\"ir?light=9PM\">Light 9PM</a></p><p><a href=\"ir?light=12AM\">Light 12AM</a></p><p><a href=\"ir?light=3AM\">Light 3AM</a></p><p><a href=\"ir?light=6AM\">Light 6AM</a></p><p><a href=\"ir?light=9AM\">Light 9AM</a></p><p><a href=\"ir?light=Cloud\">Light Cloud</a></p><p><a href=\"ir?light=Lightning\">Light Lightning</a></p><p><a href=\"ir?light=Sun\">Light Sun</a></p><p><a href=\"ir?light=Moon\">Light Moon</a></p><p><a href=\"ir?light=White\">Light White</a> | <a href=\"ir?light=WhiteUp\">Up</a> | <a href=\"ir?light=WhiteDn\">Down</a></p><p><a href=\"ir?light=Red\">Light Red</a> | <a href=\"ir?light=RedUp\">Up</a> | <a href=\"ir?light=RedDn\">Down</a></p><p><a href=\"ir?light=Green\">Light Green</a> | <a href=\"ir?light=GreenUp\">Up</a> | <a href=\"ir?light=GreenDn\">Down</a></p><p><a href=\"ir?light=Blue\">Light Blue</a> | <a href=\"ir?light=BlueUp\">Up</a> | <a href=\"ir?light=BlueDn\">Down</a></p><p><a href=\"ir?light=M1\">M1</a> | <a href=\"ir?light=M2\">M2</a> | <a href=\"ir?light=M3\">M3</a> | <a href=\"ir?light=M4\">M4</a></p></body></html>");
  }
  
  void handleIr(){
    for (uint8_t i=0; i<server.args(); i++){
      if(server.argName(i) == "tv") 
      {
          unsigned int  tv[67] = {9050,4500, 600,1700, 650,550, 600,550, 600,550, 650,550, 650,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1650, 650};  // NEC 210704FB
          irsend.sendRaw(tv, 67, 38);
      }
      else if(server.argName(i) == "light") 
      {
        if (server.arg(i) == "power") { // light on/off
          unsigned int  rawData[99] = {9050,4500, 600,1700, 650,550, 600,550, 600,550, 650,550, 650,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1650, 650};  // NEC 807F00FF
          irsend.sendRaw(rawData, 99, 38);
        }
        if (server.arg(i) == "max") { // light max
          unsigned int  rawData[99] = {9100,4500, 600,1700, 600,600, 600,600, 650,550, 650,550, 650,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1650, 600};  // NEC 807FC23D
          irsend.sendRaw(rawData, 99, 38);
        }
        if (server.arg(i) == "24hour") { // light 24-7
          unsigned int  rawData[99] = {9050,4550, 600,1700, 600,600, 650,550, 600,550, 600,600, 600,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1650, 650};  // UNKNOWN ABD4D16E
          irsend.sendRaw(rawData, 99, 38);
        }
        if (server.arg(i) == "12PM") { // light 12PM
          unsigned int  rawData[99] = {9000,4550, 600,1700, 550,600, 650,550, 600,600, 550,600, 600,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1700, 650};  // NEC 807FC03F
          irsend.sendRaw(rawData, 99, 38);
        }
        if (server.arg(i) == "3PM") { // light 3PM
          unsigned int  rawData[99] = {9050,4550, 600,1700, 600,600, 600,600, 600,550, 650,550, 600,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1700, 600};  // NEC 807F827D
          irsend.sendRaw(rawData, 99, 38);
        }
        if (server.arg(i) == "6PM") { // light 6PM
          unsigned int  rawData[99] = {9050,4500, 600,1700, 600,600, 650,550, 650,550, 600,600, 600,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1700, 650};  // NEC 807FA25D
          irsend.sendRaw(rawData, 99, 38);
      }
      if (server.arg(i) == "9PM") { // light 9PM
          unsigned int  rawData[99] = {9050,4500, 600,1700, 650,550, 650,550, 600,550, 650,550, 650,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1650, 650};  // NEC
          irsend.sendRaw(rawData, 99, 38);
        }
      if (server.arg(i) == "12AM") { // light 12AM
          unsigned int  rawData[99] = {9050,4550, 600,1700, 600,600, 650,550, 650,550, 600,550, 600,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1650, 650};  // NEC
          irsend.sendRaw(rawData, 99, 38);
        }
        if (server.arg(i) == "3AM") { // light 3AM
          unsigned int  rawData[99] = {9100,4500, 650,1650, 600,600, 600,600, 600,550, 600,600, 650,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1700, 600};  // NEC
          irsend.sendRaw(rawData, 99, 38);
        }
        if (server.arg(i) == "6AM") { // light 6AM
          unsigned int  rawData[99] = {9050,4500, 600,1700, 650,550, 600,550, 600,550, 600,550, 600,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1700, 600};  // NEC
          irsend.sendRaw(rawData, 99, 38);
        }
        if (server.arg(i) == "DEMO") { // light DEMO
          unsigned int  rawData[99] = {9100,4500, 650,1650, 600,600, 600,550, 650,550, 650,550, 600,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1650, 650};  // NEC
          irsend.sendRaw(rawData, 99, 38);
        }
      if (server.arg(i) == "Cloud") { // light Cloud
          unsigned int  rawData[99] = {9100,4500, 650,1650, 600,550, 650,550, 650,550, 600,550, 650,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1700, 600};  // NEC
          irsend.sendRaw(rawData, 99, 38);
        }
      if (server.arg(i) == "Lightning") { // light Lightning
          unsigned int  rawData[99] = {9050,4500, 650,1650, 600,550, 600,550, 600,600, 650,550, 650,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1700, 600};  // NEC
          irsend.sendRaw(rawData, 99, 38);
        }
      if (server.arg(i) == "Sun") { // light Sun
          unsigned int  rawData[99] = {9100,4500, 650,1650, 650,550, 650,550, 600,600, 650,550, 650,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1650, 600};  // NEC
          irsend.sendRaw(rawData, 99, 38);
        }
      if (server.arg(i) == "Moon") { // light Moon
          unsigned int  rawData[99] = {9050,4500, 650,1650, 650,550, 650,550, 650,550, 600,550, 600,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1650, 650};  // NEC
          irsend.sendRaw(rawData, 99, 38);
        }
      if (server.arg(i) == "White") { // light White
          unsigned int  rawData[99] = {9050,4500, 650,1650, 650,550, 600,550, 650,550, 600,550, 650,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1650, 650};  // NEC
          irsend.sendRaw(rawData, 99, 38);
        }
      if (server.arg(i) == "WhiteUp") { // light White Up
          unsigned int  rawData[99] = {9100,4500, 600,1700, 650,550, 600,550, 600,600, 600,550, 650,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1700, 600};  // NEC
          irsend.sendRaw(rawData, 99, 38);
        }
      if (server.arg(i) == "WhiteDn") { // light White Down
          unsigned int  rawData[99] = {9100,4500, 600,1700, 650,550, 600,550, 600,550, 600,550, 650,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1650, 600};  // NEC
          irsend.sendRaw(rawData, 99, 38);
        }
      if (server.arg(i) == "Red") { // light Red
          unsigned int  rawData[99] = {9050,4500, 650,1650, 650,550, 600,550, 650,550, 650,550, 650,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1700, 650};  // NEC
          irsend.sendRaw(rawData, 99, 38);
        }
      if (server.arg(i) == "RedUp") { // light Red Up
          unsigned int  rawData[99] = {9100,4500, 600,1700, 650,550, 650,550, 650,500, 650,550, 650,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1700, 650};  // NEC
          irsend.sendRaw(rawData, 99, 38);
        }
      if (server.arg(i) == "RedDn") { // light Red Down
          unsigned int  rawData[99] = {9100,4500, 650,1650, 600,550, 650,500, 650,550, 650,550, 600,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1650, 600};  // NEC
          irsend.sendRaw(rawData, 99, 38);
        }
      if (server.arg(i) == "Green") { // light Green
          unsigned int  rawData[99] = {9100,4500, 650,1650, 600,550, 600,600, 650,550, 650,550, 600,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1650, 650};  // NEC
          irsend.sendRaw(rawData, 99, 38);
        }
      if (server.arg(i) == "GreenUp") { // light Green Up
          unsigned int  rawData[99] = {9100,4500, 600,1700, 650,550, 650,550, 600,550, 600,550, 600,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1650, 600};  // NEC
          irsend.sendRaw(rawData, 99, 38);
        }
      if (server.arg(i) == "GreenDn") { // light Green Down
          unsigned int  rawData[99] = {9100,4500, 600,1700, 650,550, 600,550, 600,550, 600,550, 650,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1650, 600};  // NEC
          irsend.sendRaw(rawData, 99, 38);
      }
      if (server.arg(i) == "Blue") { // light Blue
          unsigned int  rawData[99] = {9100,4500, 600,1700, 650,550, 650,550, 600,550, 650,550, 600,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1650, 600};  // NEC
          irsend.sendRaw(rawData, 99, 38);
        }
      if (server.arg(i) == "BlueUp") { // light Blue Up
          unsigned int  rawData[99] = {9100,4500, 650,1650, 600,550, 600,550, 600,550, 650,550, 600,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1700, 600};  // NEC
          irsend.sendRaw(rawData, 99, 38);
        }
      if (server.arg(i) == "BlueDn") { // light Blue Down
          unsigned int  rawData[99] = {9050,4500, 600,1700, 650,550, 650,550, 600,550, 600,550, 600,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1650, 600};  // NEC
          irsend.sendRaw(rawData, 99, 38);
        }
      if (server.arg(i) == "M1") { // light M1
          unsigned int  rawData[99] = {9100,4500, 650,1650, 600,550, 600,600, 650,550, 650,550, 650,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1700, 650};  // NEC
          irsend.sendRaw(rawData, 99, 38);
        }
      if (server.arg(i) == "M2") { // light M2
          unsigned int  rawData[99] = {9100,4500, 650,1650, 650,550, 600,550, 650,500, 650,550, 600,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1700, 650};  // NEC
          irsend.sendRaw(rawData, 99, 38);
        }
      if (server.arg(i) == "M3") { // light M3
          unsigned int  rawData[99] = {9100,4500, 650,1650, 600,550, 600,550, 650,550, 650,550, 650,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1650, 600};  // NEC
          irsend.sendRaw(rawData, 99, 38);
        }
      if (server.arg(i) == "M4") { // light M4
          unsigned int  rawData[99] = {9050,4500, 650,1650, 600,550, 600,550, 600,550, 600,550, 650,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1700, 600};  // NEC
          irsend.sendRaw(rawData, 99, 38);
        }
      }
    }
    handleRoot();
  }
  
  void handleNotFound(){
    String message = "File Not Found\n\n";
    message += "URI: ";
    message += server.uri();
    message += "\nMethod: ";
    message += (server.method() == HTTP_GET)?"GET":"POST";
    message += "\nArguments: ";
    message += server.args();
    message += "\n";
    for (uint8_t i=0; i<server.args(); i++){
      message += " " + server.argName(i) + ": " + server.arg(i) + "\n";
    }
    server.send(404, "text/plain", message);
  }
   
  void setup(void){
    irsend.begin();
    
    //Serial.begin(9600);
    pinMode(TRIGGER_PIN, INPUT);
    if ( digitalRead(TRIGGER_PIN) == HIGH ) {
      WiFiManager wifiManager;
      //wifiManager.startConfigPortal("OnDemandAP");
      wifiManager.resetSettings();
    } else {
      WiFiManager wifiManager;
      wifiManager.autoConnect();
    }
    //Serial.print("IP address: ");
    //Serial.println(WiFi.localIP());
    
    if (mdns.begin("esp8266", WiFi.localIP())) {
      //Serial.println("MDNS responder started");
    }
    
    server.on("/", handleRoot);
    server.on("/ir", handleIr); 
   
    server.on("/inline", [](){
      server.send(200, "text/plain", "this works as well");
    });
  
    server.onNotFound(handleNotFound);
    
    server.begin();
    //Serial.println("HTTP server started");
  }
   
  void loop(void){
    server.handleClient();
  
  } 

